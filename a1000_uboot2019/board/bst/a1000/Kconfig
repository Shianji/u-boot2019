## a1000_uboot2019/board/bst/a1000/Kconfig
```kconfig
if TARGET_BST_A1000

config SYS_BOARD
	default "a1000"

config SYS_VENDOR
	default "bst"

config SYS_SOC
	default "a1000"

config SYS_CONFIG_NAME
	default "bsta1000"

source "board/bst/common/Kconfig"

endif

config BST_BURN_TOOLS
	bool "A1000 BURN Tools"
	default n
	select BSTDDR4_USEDTS
	help
		This option is used by the burning tool for
		the first time to burn the u-boot-full.img.
```

## a1000_uboot2019/board/bst/a1000b/Kconfig
```kconfig
if TARGET_BST_A1000B

config SYS_BOARD
	default "a1000b"

config SYS_VENDOR
	default "bst"

config SYS_SOC
	default "a1000b"

config SYS_CONFIG_NAME
	default "bsta1000b"

source "board/bst/common/Kconfig"

endif

config BST_BURN_TOOLS
	bool "A1000B BURN Tools"
	default n
	select BSTDDR4_USEDTS
	help
		This option is used by the burning tool for
		the first time to burn the u-boot-full.img.
```

## a1000_uboot2019/board/bst/common/Kconfig
```kconfig
# SPDX-License-Identifier: GPL-2.0+

menuconfig USB_CFG_BLOCK
	bool "Enable usb config block support"
	help
		The usb config block stored production data on the on - module
		flash device(NAND, NOR or eMMC).The area is normally preserved by
		software and contains the serial number(out of which the MAC
		address is generated)and the exact module type.

if USB_CFG_BLOCK
	config USB_CFG_BLOCK_IS_IN_MMC
		bool "usb config in mmc"
		default n
	config USB_CFG_BLOCK_IS_IN_NAND
		bool "usb config in nand flash"
		default n
	config USB_CFG_BLOCK_IS_IN_NOR
		bool "usb config in nor flash"
		default n
	config USB_CFG_BLOCK_IS_IN_QSPI
		bool "usb config in qspi flash"
		default n
	config USB_CFG_BLOCK_DEV
		int "usb config block eMMC device ID"
		depends on USB_CFG_BLOCK_IS_IN_MMC
	config USB_CFG_BLOCK_PART
		int "usb config block eMMC partition ID"
		depends on USB_CFG_BLOCK_IS_IN_MMC
	config USB_CFG_BLOCK_OFFSET
		hex "usb config block offset"
		default 0xcd0000
	help
		Specify the byte offset of the usb config block within the flash
		device the config block is stored on.

endif
```

## a1000_uboot2019/configs/bsta1000_defconfig
```kconfig
CONFIG_ARM=y
CONFIG_POSITION_INDEPENDENT=y
CONFIG_ARM_SMCCC=y
CONFIG_TARGET_BST_A1000=y
CONFIG_SPL_LDSCRIPT=""
CONFIG_SYS_TEXT_BASE=0x0
CONFIG_SPL_GPIO_SUPPORT=y
CONFIG_SPL_LIBCOMMON_SUPPORT=y
CONFIG_SPL_LIBGENERIC_SUPPORT=y
CONFIG_SYS_MALLOC_F_LEN=0x4000
CONFIG_SPL_MMC_SUPPORT=y
CONFIG_SPL_SERIAL_SUPPORT=y
CONFIG_SPL_SYS_MALLOC_F_LEN=0x2800
#CONFIG_SPL=y
CONFIG_IDENT_STRING="Bst A1000"
CONFIG_SPL_SPI_FLASH_SUPPORT=y
CONFIG_SPL_SPI_SUPPORT=y
CONFIG_ARMV8_MULTIENTRY=y
# CONFIG_PSCI_RESET is not set
CONFIG_BSTDDR4_USEDTS=y
# CONFIG_LOCALVERSION_AUTO is not set
CONFIG_ENV_VARS_UBOOT_CONFIG=y
CONFIG_NR_DRAM_BANKS=2
CONFIG_TPL_SYS_MALLOC_F_LEN=0x2800
# CONFIG_SYS_MALLOC_CLEAR_ON_INIT is not set
# CONFIG_ANDROID_BOOT_IMAGE is not set
CONFIG_FIT=y
CONFIG_SPL_LOAD_FIT=y
# CONFIG_ARCH_FIXUP_FDT_MEMORY is not set
CONFIG_BOOTDELAY=3
CONFIG_USE_BOOTCOMMAND=y
CONFIG_BOOTCOMMAND="bootm 0x81ffffc0#config-evb"
CONFIG_SUPPORT_RAW_INITRD=y
# CONFIG_DISPLAY_CPUINFO is not set
CONFIG_BOARD_TYPES=y
CONFIG_LAST_STAGE_INIT=y
CONFIG_SPL_BOARD_INIT=y
# CONFIG_TPL_BANNER_PRINT is not set
# CONFIG_SPL_CRC32_SUPPORT is not set
CONFIG_SPL_ENV_SUPPORT=y
CONFIG_SPL_SAVEENV=y
CONFIG_SPL_FS_EXT4=y
CONFIG_SPL_I2C_SUPPORT=y
CONFIG_SPL_MMC_WRITE=y
CONFIG_SPL_MTD_SUPPORT=y
CONFIG_SPL_DM_RESET=y
CONFIG_SPL_RAM_SUPPORT=y
CONFIG_SPL_RAM_DEVICE=y
CONFIG_SPL_WATCHDOG_SUPPORT=y
CONFIG_HUSH_PARSER=y
CONFIG_SYS_PROMPT="u-boot> "
# CONFIG_CMD_IMI is not set
# CONFIG_CMD_XIMG is not set
CONFIG_CMD_MEMTEST=y
CONFIG_SRAM_FASTBOOT=y
#CONFIG_CMD_I2C=y
CONFIG_CMD_MMC=y
# CONFIG_CMD_MMC_RPMB is not set
CONFIG_CMD_PART=y
# CONFIG_CMD_PINMUX is not set
CONFIG_CMD_SF=y
CONFIG_CMD_SF_TEST=y
CONFIG_CMD_SPI=y
# CONFIG_CMD_ITEST is not set
# CONFIG_CMD_SOURCE is not set
# CONFIG_CMD_SETEXPR is not set
CONFIG_CMD_DHCP=y
CONFIG_CMD_MII=y
CONFIG_CMD_PING=y
CONFIG_CMD_EXT2=y
CONFIG_CMD_EXT4=y
CONFIG_CMD_EXT4_WRITE=y
CONFIG_CMD_FAT=y
CONFIG_CMD_GPT=y
CONFIG_CMD_FS_GENERIC=y
CONFIG_ISO_PARTITION=y
CONFIG_EFI_PARTITION=y
CONFIG_OF_CONTROL=y
CONFIG_SPL_OF_CONTROL=y
CONFIG_DEFAULT_DEVICE_TREE="bsta1000-baseboard"
CONFIG_OF_LIST="bsta1000-baseboard"
CONFIG_OF_SPL_REMOVE_PROPS=""
CONFIG_ENV_IS_IN_NVRAM=y
CONFIG_USE_ENV_SPI_BUS=y
CONFIG_ENV_SPI_BUS=0
#CONFIG_NET_RANDOM_ETHADDR=y
#CONFIG_NETCONSOLE=y
# CONFIG_DM_DEVICE_REMOVE is not set
# CONFIG_DM_STDIO is not set
CONFIG_SPL_DM_SEQ_ALIAS=y
CONFIG_REGMAP=y
CONFIG_DEVRES=y
CONFIG_USB_FUNCTION_FASTBOOT=y
CONFIG_UDP_FUNCTION_FASTBOOT=y
CONFIG_FASTBOOT_BUF_ADDR=0xA0000000
CONFIG_FASTBOOT_BUF_SIZE=0x3000000
CONFIG_FASTBOOT_FLASH=y
CONFIG_FASTBOOT_FLASH_MMC_DEV=0
CONFIG_DM_GPIO=y
CONFIG_DWAPB_GPIO=y
CONFIG_DM_I2C=y
CONFIG_I2C_SET_DEFAULT_BUS_NUM=y
CONFIG_SYS_I2C_DW=y
CONFIG_MISC=y
CONFIG_I2C_EEPROM=y
CONFIG_DM_MMC=y
CONFIG_SUPPORT_EMMC_RPMB=y
# CONFIG_MMC_VERBOSE is not set
CONFIG_MMC_SDHCI=y
CONFIG_MMC_SDHCI_SDMA=y
CONFIG_MMC_SDHCI_BST=y
CONFIG_DM_SPI_FLASH=y
CONFIG_SPI_FLASH=y
CONFIG_SPI_FLASH_BAR=y
CONFIG_SPI_FLASH_GIGADEVICE=y
CONFIG_SPI_FLASH_WINBOND=y
# CONFIG_SPI_FLASH_USE_4K_SECTORS is not set
CONFIG_PHY_BROADCOM=y
CONFIG_PHY_MARVELL=y
CONFIG_DM_ETH=y
CONFIG_DWC_ETH_QOS_BST=y
CONFIG_RGMII=y
CONFIG_PINCTRL=y
# CONFIG_PINCTRL_GENERIC is not set
CONFIG_SPL_PINCTRL=y
# CONFIG_SPL_PINCTRL_FULL is not set
CONFIG_PINCTRL_BST=y
CONFIG_PHY=y
CONFIG_PHY_BST_USB=y
CONFIG_DM_RESET=y
# CONFIG_SPECIFY_CONSOLE_INDEX is not set
# CONFIG_TPL_SERIAL_PRESENT is not set
CONFIG_DM_SERIAL=y
# CONFIG_SPL_DM_SERIAL is not set
CONFIG_BST_SERIAL=y
CONFIG_SPI=y
CONFIG_DM_SPI=y
CONFIG_DESIGNWARE_QSPI=y
CONFIG_USB=y
CONFIG_DM_USB=y
CONFIG_DM_USB_GADGET=y
CONFIG_USB_DWC3=y
CONFIG_USB_DWC3_GADGET=y
CONFIG_USB_DWC3_GENERIC=y
CONFIG_USB_GADGET=y
CONFIG_USB_GADGET_MANUFACTURER="xiaomi"
CONFIG_USB_GADGET_VENDOR_NUM=0x18d1
CONFIG_USB_GADGET_PRODUCT_NUM=0x4ee7
CONFIG_USB_ETHER=y
CONFIG_FAT_WRITE=y
CONFIG_PANIC_HANG=y
CONFIG_HEXDUMP=y
CONFIG_OF_LIBFDT_OVERLAY=y
# CONFIG_EFI_LOADER is not set
CONFIG_LZ4=y
CONFIG_MISC_INIT_R=y
# CONFIG_CMD_NET is not set
# CONFIG_NET is not set
```

## a1000_uboot2019_analysis/drivers/phy/bst/Kconfig
```kconfig
# SPDX-License-Identifier: GPL-2.0-only
#
# Phy drivers for BST platforms
#
config PHY_BST_USB
	tristate "Black Sesame Technologies USB PHY Driver"
	select GENERIC_PHY
	help
	  Enable this to support the USB PHY on BST SoCs.
	  This driver controls both the
	  USB 2 PHY and the USB 3 PHY.
	  usb2 and usb3 are distinguished by usb_mode in dts file.
```
